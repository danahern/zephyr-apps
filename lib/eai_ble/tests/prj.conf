## CMakeLists.txt
```
cmake_minimum_required(VERSION 3.20.0)

find_package(Zephyr REQUIRED HINTS $ENV{ZEPHYR_BASE})
project(eai_ble_test)

target_sources(app PRIVATE src/main.c)
```

## prj.conf
```kconfig
CONFIG_BT=y
CONFIG_BT_PERIPHERAL=y
CONFIG_BT_GATT_DYNAMIC_DB=y
CONFIG_BT_DEVICE_NAME="eai_ble_test"

CONFIG_EAI_BLE=y
```

## src/main.c
```c
/*
 * eai_ble build-only compile verification.
 *
 * Verifies that the Zephyr backend compiles correctly with BT enabled.
 * Not a functional test — just ensures headers and symbols resolve.
 */

#include <eai_ble/eai_ble.h>
#include <stddef.h>

int main(void)
{
	eai_ble_init(NULL);
	return 0;
}
```
