## CMakeLists.txt
```
cmake_minimum_required(VERSION 3.20.0)

find_package(Zephyr REQUIRED HINTS $ENV{ZEPHYR_BASE})
project(eai_wifi_test)

target_sources(app PRIVATE src/main.c)
```

## prj.conf
```kconfig
CONFIG_WIFI=y
CONFIG_NETWORKING=y
CONFIG_NET_MGMT=y
CONFIG_NET_MGMT_EVENT=y
CONFIG_NET_MGMT_EVENT_INFO=y
CONFIG_NET_IPV4=y
CONFIG_NET_DHCPV4=y
CONFIG_NET_L2_ETHERNET=y
CONFIG_NET_L2_WIFI_MGMT=y

# Random (needed by networking stack; test-only non-crypto source)
CONFIG_TEST_RANDOM_GENERATOR=y

# Heap (needed by WiFi driver)
CONFIG_HEAP_MEM_POOL_SIZE=4096

CONFIG_EAI_WIFI=y
```

## src/main.c
```c
/*
 * eai_wifi build-only compile verification.
 *
 * Verifies that the Zephyr backend compiles correctly with WiFi enabled.
 * Not a functional test — just ensures headers and symbols resolve.
 */

#include <eai_wifi/eai_wifi.h>
#include <stddef.h>

int main(void)
{
	eai_wifi_init();
	return 0;
}
```
