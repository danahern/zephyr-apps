## CMakeLists.txt
```
cmake_minimum_required(VERSION 3.20.0)

# wifi_prov is already discovered via zephyr-apps/zephyr/module.yml
# No ZEPHYR_EXTRA_MODULES needed

find_package(Zephyr REQUIRED HINTS $ENV{ZEPHYR_BASE})
project(wifi_prov_test)

target_sources(app PRIVATE
    src/main.c
    src/test_cred.c
    src/test_msg.c
    src/test_sm.c
)
```

## prj.conf
```kconfig
CONFIG_ZTEST=y
CONFIG_MAIN_STACK_SIZE=2048

# Settings subsystem (uses "none" backend on QEMU — RAM only)
CONFIG_SETTINGS=y
CONFIG_SETTINGS_RUNTIME=y

# WiFi provisioning library
CONFIG_WIFI_PROV=y
CONFIG_WIFI_PROV_CRED=y
```

## src/test_cred.c
```c
#include <zephyr/ztest.h>
#include <zephyr/settings/settings.h>
#include <string.h>
#include <wifi_prov/wifi_prov.h>

static void *cred_setup(void)
{
	settings_subsys_init();
	wifi_prov_cred_erase();
	return NULL;
}

static void cred_before(void *fixture)
{
	ARG_UNUSED(fixture);
	wifi_prov_cred_erase();
}

ZTEST(wifi_prov_cred, test_no_cred_on_clean_boot)
{
	zassert_false(wifi_prov_cred_exists(),
		      "No credentials should exist after erase");
}

ZTEST(wifi_prov_cred, test_store_and_load)
{
	struct wifi_prov_cred cred = {
		.ssid = "TestNetwork",
		.ssid_len = 11,
		.psk = "password123",
		.psk_len = 11,
		.security = WIFI_PROV_SEC_WPA2_PSK,
	};
	struct wifi_prov_cred loaded = {0};

	zassert_ok(wifi_prov_cred_store(&cred), "Store should succeed");
	zassert_true(wifi_prov_cred_exists(), "Credentials should exist after store");
	zassert_ok(wifi_prov_cred_load(&loaded), "Load should succeed");
	zassert_equal(loaded.ssid_len, 11, "SSID length mismatch");
	zassert_mem_equal(loaded.ssid, "TestNetwork", 11, "SSID mismatch");
	zassert_equal(loaded.psk_len, 11, "PSK length mismatch");
	zassert_mem_equal(loaded.psk, "password123", 11, "PSK mismatch");
	zassert_equal(loaded.security, WIFI_PROV_SEC_WPA2_PSK, "Security mismatch");
}

ZTEST(wifi_prov_cred, test_erase)
{
	struct wifi_prov_cred cred = {
		.ssid = "ToErase",
		.ssid_len = 7,
		.psk = "pass",
		.psk_len = 4,
		.security = WIFI_PROV_SEC_WPA_PSK,
	};

	zassert_ok(wifi_prov_cred_store(&cred), "Store should succeed");
	zassert_true(wifi_prov_cred_exists(), "Should exist after store");
	zassert_ok(wifi_prov_cred_erase(), "Erase should succeed");
	zassert_false(wifi_prov_cred_exists(), "Should not exist after erase");
}

ZTEST(wifi_prov_cred, test_load_when_empty)
{
	struct wifi_prov_cred loaded = {0};
	int ret = wifi_prov_cred_load(&loaded);

	zassert_equal(ret, -ENOENT,
		      "Load should return -ENOENT when empty, got %d", ret);
}

ZTEST(wifi_prov_cred, test_overwrite)
{
	struct wifi_prov_cred first = {
		.ssid = "First",
		.ssid_len = 5,
		.psk = "pass1",
		.psk_len = 5,
		.security = WIFI_PROV_SEC_WPA_PSK,
	};
	struct wifi_prov_cred second = {
		.ssid = "Second",
		.ssid_len = 6,
		.psk = "pass2",
		.psk_len = 5,
		.security = WIFI_PROV_SEC_WPA2_PSK,
	};
	struct wifi_prov_cred loaded = {0};

	zassert_ok(wifi_prov_cred_store(&first), "First store should succeed");
	zassert_ok(wifi_prov_cred_store(&second), "Second store should succeed");
	zassert_ok(wifi_prov_cred_load(&loaded), "Load should succeed");
	zassert_equal(loaded.ssid_len, 6, "Should have second SSID length");
	zassert_mem_equal(loaded.ssid, "Second", 6, "Should have second SSID");
}

ZTEST_SUITE(wifi_prov_cred, NULL, cred_setup, cred_before, NULL, NULL);
```

## src/test_msg.c
```c
#include <zephyr/ztest.h>
#include <string.h>
#include <wifi_prov/wifi_prov_msg.h>

ZTEST(wifi_prov_msg, test_encode_decode_scan_result)
{
	struct wifi_prov_scan_result orig = {
		.ssid = "MyWiFi",
		.ssid_len = 6,
		.rssi = -42,
		.security = WIFI_PROV_SEC_WPA2_PSK,
		.channel = 6,
	};
	struct wifi_prov_scan_result decoded = {0};
	uint8_t buf[64];

	int len = wifi_prov_msg_encode_scan_result(&orig, buf, sizeof(buf));

	zassert_true(len > 0, "Encode should return positive length, got %d", len);
	zassert_ok(wifi_prov_msg_decode_scan_result(buf, len, &decoded));
	zassert_equal(decoded.ssid_len, 6);
	zassert_mem_equal(decoded.ssid, "MyWiFi", 6);
	zassert_equal(decoded.rssi, -42);
	zassert_equal(decoded.security, WIFI_PROV_SEC_WPA2_PSK);
	zassert_equal(decoded.channel, 6);
}

ZTEST(wifi_prov_msg, test_encode_decode_credentials)
{
	struct wifi_prov_cred orig = {
		.ssid = "HomeNet",
		.ssid_len = 7,
		.psk = "secret123",
		.psk_len = 9,
		.security = WIFI_PROV_SEC_WPA2_PSK,
	};
	struct wifi_prov_cred decoded = {0};
	uint8_t buf[128];

	int len = wifi_prov_msg_encode_credentials(&orig, buf, sizeof(buf));

	zassert_true(len > 0, "Encode should return positive length, got %d", len);
	zassert_ok(wifi_prov_msg_decode_credentials(buf, len, &decoded));
	zassert_equal(decoded.ssid_len, 7);
	zassert_mem_equal(decoded.ssid, "HomeNet", 7);
	zassert_equal(decoded.psk_len, 9);
	zassert_mem_equal(decoded.psk, "secret123", 9);
	zassert_equal(decoded.security, WIFI_PROV_SEC_WPA2_PSK);
}

ZTEST(wifi_prov_msg, test_encode_decode_status)
{
	uint8_t ip_orig[4] = {192, 168, 1, 42};
	uint8_t ip_decoded[4] = {0};
	enum wifi_prov_state state;
	uint8_t buf[8];

	int len = wifi_prov_msg_encode_status(WIFI_PROV_STATE_CONNECTED,
					      ip_orig, buf, sizeof(buf));

	zassert_equal(len, 5, "Status should always be 5 bytes");
	zassert_ok(wifi_prov_msg_decode_status(buf, len, &state, ip_decoded));
	zassert_equal(state, WIFI_PROV_STATE_CONNECTED);
	zassert_mem_equal(ip_decoded, ip_orig, 4, "IP address mismatch");
}

ZTEST(wifi_prov_msg, test_decode_truncated_scan_result)
{
	/* Only 2 bytes — too short for any valid scan result */
	uint8_t buf[] = {6, 'A'};
	struct wifi_prov_scan_result result;

	zassert_equal(wifi_prov_msg_decode_scan_result(buf, sizeof(buf), &result),
		      -EINVAL, "Should reject truncated scan result");
}

ZTEST(wifi_prov_msg, test_decode_truncated_credentials)
{
	/* ssid_len=5 but only 3 bytes total */
	uint8_t buf[] = {5, 'A', 'B'};
	struct wifi_prov_cred cred;

	zassert_equal(wifi_prov_msg_decode_credentials(buf, sizeof(buf), &cred),
		      -EINVAL, "Should reject truncated credentials");
}

ZTEST(wifi_prov_msg, test_encode_buffer_too_small)
{
	struct wifi_prov_scan_result result = {
		.ssid = "Test",
		.ssid_len = 4,
		.rssi = -50,
		.security = 0,
		.channel = 1,
	};
	uint8_t buf[2]; /* Too small for 4 + 1 + 3 = 8 bytes */

	zassert_equal(wifi_prov_msg_encode_scan_result(&result, buf, sizeof(buf)),
		      -ENOBUFS, "Should return -ENOBUFS for small buffer");
}

ZTEST(wifi_prov_msg, test_max_length_ssid)
{
	struct wifi_prov_scan_result orig = {
		.ssid_len = WIFI_PROV_SSID_MAX_LEN,
		.rssi = -80,
		.security = WIFI_PROV_SEC_WPA3_SAE,
		.channel = 36,
	};
	struct wifi_prov_scan_result decoded = {0};
	uint8_t buf[64];

	memset(orig.ssid, 'X', WIFI_PROV_SSID_MAX_LEN);

	int len = wifi_prov_msg_encode_scan_result(&orig, buf, sizeof(buf));

	zassert_true(len > 0, "Should encode 32-byte SSID");
	zassert_ok(wifi_prov_msg_decode_scan_result(buf, len, &decoded));
	zassert_equal(decoded.ssid_len, WIFI_PROV_SSID_MAX_LEN);
}

ZTEST(wifi_prov_msg, test_empty_psk)
{
	struct wifi_prov_cred orig = {
		.ssid = "OpenNet",
		.ssid_len = 7,
		.psk_len = 0,
		.security = WIFI_PROV_SEC_NONE,
	};
	struct wifi_prov_cred decoded = {0};
	uint8_t buf[64];

	int len = wifi_prov_msg_encode_credentials(&orig, buf, sizeof(buf));

	zassert_true(len > 0, "Should encode open network credentials");
	zassert_ok(wifi_prov_msg_decode_credentials(buf, len, &decoded));
	zassert_equal(decoded.psk_len, 0, "PSK should be empty");
	zassert_equal(decoded.security, WIFI_PROV_SEC_NONE);
}

ZTEST_SUITE(wifi_prov_msg, NULL, NULL, NULL, NULL, NULL);
```

## src/test_sm.c
```c
#include <zephyr/ztest.h>
#include <wifi_prov/wifi_prov.h>

static enum wifi_prov_state cb_old_state;
static enum wifi_prov_state cb_new_state;
static int cb_count;

static void test_state_callback(enum wifi_prov_state old_state,
				enum wifi_prov_state new_state)
{
	cb_old_state = old_state;
	cb_new_state = new_state;
	cb_count++;
}

static void sm_before(void *fixture)
{
	ARG_UNUSED(fixture);
	cb_count = 0;
	cb_old_state = WIFI_PROV_STATE_IDLE;
	cb_new_state = WIFI_PROV_STATE_IDLE;
	wifi_prov_sm_init(test_state_callback);
}

ZTEST(wifi_prov_sm, test_initial_state_is_idle)
{
	zassert_equal(wifi_prov_sm_get_state(), WIFI_PROV_STATE_IDLE,
		      "Initial state should be IDLE");
}

ZTEST(wifi_prov_sm, test_scan_flow)
{
	zassert_ok(wifi_prov_sm_process_event(WIFI_PROV_EVT_SCAN_TRIGGER));
	zassert_equal(wifi_prov_sm_get_state(), WIFI_PROV_STATE_SCANNING);

	zassert_ok(wifi_prov_sm_process_event(WIFI_PROV_EVT_SCAN_DONE));
	zassert_equal(wifi_prov_sm_get_state(), WIFI_PROV_STATE_SCAN_COMPLETE);
}

ZTEST(wifi_prov_sm, test_provision_flow)
{
	/* Get to SCAN_COMPLETE */
	wifi_prov_sm_process_event(WIFI_PROV_EVT_SCAN_TRIGGER);
	wifi_prov_sm_process_event(WIFI_PROV_EVT_SCAN_DONE);

	zassert_ok(wifi_prov_sm_process_event(WIFI_PROV_EVT_CREDENTIALS_RX));
	zassert_equal(wifi_prov_sm_get_state(), WIFI_PROV_STATE_PROVISIONING);

	zassert_ok(wifi_prov_sm_process_event(WIFI_PROV_EVT_WIFI_CONNECTING));
	zassert_equal(wifi_prov_sm_get_state(), WIFI_PROV_STATE_CONNECTING);

	zassert_ok(wifi_prov_sm_process_event(WIFI_PROV_EVT_WIFI_CONNECTED));
	zassert_equal(wifi_prov_sm_get_state(), WIFI_PROV_STATE_CONNECTED);
}

ZTEST(wifi_prov_sm, test_connection_failure)
{
	/* Get to CONNECTING */
	wifi_prov_sm_process_event(WIFI_PROV_EVT_SCAN_TRIGGER);
	wifi_prov_sm_process_event(WIFI_PROV_EVT_SCAN_DONE);
	wifi_prov_sm_process_event(WIFI_PROV_EVT_CREDENTIALS_RX);
	wifi_prov_sm_process_event(WIFI_PROV_EVT_WIFI_CONNECTING);

	zassert_ok(wifi_prov_sm_process_event(WIFI_PROV_EVT_WIFI_FAILED));
	zassert_equal(wifi_prov_sm_get_state(), WIFI_PROV_STATE_IDLE,
		      "Should return to IDLE on failure");
}

ZTEST(wifi_prov_sm, test_disconnect)
{
	/* Get to CONNECTED */
	wifi_prov_sm_process_event(WIFI_PROV_EVT_SCAN_TRIGGER);
	wifi_prov_sm_process_event(WIFI_PROV_EVT_SCAN_DONE);
	wifi_prov_sm_process_event(WIFI_PROV_EVT_CREDENTIALS_RX);
	wifi_prov_sm_process_event(WIFI_PROV_EVT_WIFI_CONNECTING);
	wifi_prov_sm_process_event(WIFI_PROV_EVT_WIFI_CONNECTED);

	zassert_ok(wifi_prov_sm_process_event(WIFI_PROV_EVT_WIFI_DISCONNECTED));
	zassert_equal(wifi_prov_sm_get_state(), WIFI_PROV_STATE_IDLE);
}

ZTEST(wifi_prov_sm, test_factory_reset_from_connected)
{
	/* Get to CONNECTED */
	wifi_prov_sm_process_event(WIFI_PROV_EVT_SCAN_TRIGGER);
	wifi_prov_sm_process_event(WIFI_PROV_EVT_SCAN_DONE);
	wifi_prov_sm_process_event(WIFI_PROV_EVT_CREDENTIALS_RX);
	wifi_prov_sm_process_event(WIFI_PROV_EVT_WIFI_CONNECTING);
	wifi_prov_sm_process_event(WIFI_PROV_EVT_WIFI_CONNECTED);

	zassert_ok(wifi_prov_sm_process_event(WIFI_PROV_EVT_FACTORY_RESET));
	zassert_equal(wifi_prov_sm_get_state(), WIFI_PROV_STATE_IDLE);
}

ZTEST(wifi_prov_sm, test_factory_reset_from_scanning)
{
	wifi_prov_sm_process_event(WIFI_PROV_EVT_SCAN_TRIGGER);
	zassert_equal(wifi_prov_sm_get_state(), WIFI_PROV_STATE_SCANNING);

	zassert_ok(wifi_prov_sm_process_event(WIFI_PROV_EVT_FACTORY_RESET));
	zassert_equal(wifi_prov_sm_get_state(), WIFI_PROV_STATE_IDLE);
}

ZTEST(wifi_prov_sm, test_invalid_transition)
{
	/* IDLE + SCAN_DONE should be invalid */
	int ret = wifi_prov_sm_process_event(WIFI_PROV_EVT_SCAN_DONE);

	zassert_equal(ret, -EPERM, "Should return -EPERM for invalid transition");
	zassert_equal(wifi_prov_sm_get_state(), WIFI_PROV_STATE_IDLE,
		      "State should not change on invalid transition");
}

ZTEST(wifi_prov_sm, test_state_change_callback)
{
	int initial_count = cb_count;

	wifi_prov_sm_process_event(WIFI_PROV_EVT_SCAN_TRIGGER);

	zassert_equal(cb_count, initial_count + 1, "Callback should fire once");
	zassert_equal(cb_old_state, WIFI_PROV_STATE_IDLE, "Old state should be IDLE");
	zassert_equal(cb_new_state, WIFI_PROV_STATE_SCANNING,
		      "New state should be SCANNING");
}

ZTEST_SUITE(wifi_prov_sm, NULL, NULL, sm_before, NULL, NULL);
```
