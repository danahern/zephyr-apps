## CMakeLists.txt
```
cmake_minimum_required(VERSION 3.20.0)

find_package(Zephyr REQUIRED HINTS $ENV{ZEPHYR_BASE})
project(wifi_provision)

target_sources(app PRIVATE
    src/main.c
    src/throughput_server.c
)

target_include_directories(app PRIVATE src)
```

## prj.conf
```kconfig
# EAI abstraction layer dependencies (required by wifi_prov)
CONFIG_EAI_LOG=y
CONFIG_EAI_BLE=y
CONFIG_EAI_WIFI=y
CONFIG_EAI_SETTINGS=y
CONFIG_EAI_OSAL=y

# WiFi provisioning library
CONFIG_WIFI_PROV=y
CONFIG_WIFI_PROV_BLE=y
CONFIG_WIFI_PROV_WIFI=y
CONFIG_WIFI_PROV_CRED=y
CONFIG_WIFI_PROV_AUTO_CONNECT=y

# Bluetooth
CONFIG_BT=y
CONFIG_BT_PERIPHERAL=y
CONFIG_BT_DEVICE_NAME="WiFi Prov"
CONFIG_BT_MAX_CONN=1
CONFIG_BT_ATT_PREPARE_COUNT=2
CONFIG_BT_L2CAP_TX_MTU=100
CONFIG_BT_BUF_ACL_RX_SIZE=104

# WiFi
CONFIG_WIFI=y

# Networking
CONFIG_NETWORKING=y
CONFIG_NET_IPV4=y
CONFIG_NET_TCP=y
CONFIG_NET_SOCKETS=y
CONFIG_NET_DHCPV4=y
CONFIG_NET_L2_ETHERNET=y

# Network management
CONFIG_NET_MGMT=y
CONFIG_NET_MGMT_EVENT=y
CONFIG_NET_MGMT_EVENT_INFO=y
CONFIG_NET_L2_WIFI_MGMT=y

# Settings for credential persistence
CONFIG_SETTINGS=y
CONFIG_NVS=y
CONFIG_SETTINGS_NVS=y
CONFIG_FLASH=y
CONFIG_FLASH_MAP=y

# Logging via RTT
CONFIG_LOG=y
CONFIG_LOG_DEFAULT_LEVEL=3
CONFIG_USE_SEGGER_RTT=y
CONFIG_LOG_BACKEND_RTT=y
CONFIG_LOG_BUFFER_SIZE=4096
CONFIG_SEGGER_RTT_BUFFER_SIZE_UP=4096

# Stack sizes
CONFIG_MAIN_STACK_SIZE=4096
CONFIG_SYSTEM_WORKQUEUE_STACK_SIZE=8192
CONFIG_NET_MGMT_EVENT_STACK_SIZE=2048

# Heap
CONFIG_HEAP_MEM_POOL_SIZE=8192
```

## boards/esp32_devkitc_esp32_procpu.conf
```kconfig
# ESP32: Built-in WiFi
CONFIG_ESP32_USE_UNSUPPORTED_REVISION=y

# POSIX API for sockets
CONFIG_POSIX_API=y

# Net buffers
CONFIG_NET_PKT_RX_COUNT=16
CONFIG_NET_PKT_TX_COUNT=16
CONFIG_NET_BUF_RX_COUNT=32
CONFIG_NET_BUF_TX_COUNT=32
CONFIG_NET_MAX_CONN=4
CONFIG_NET_MAX_CONTEXTS=8
```

## boards/nrf7002dk_nrf5340_cpuapp.conf
```kconfig
# nRF7002-DK: nRF5340 + nRF7002 companion WiFi IC
CONFIG_NUM_PREEMPT_PRIORITIES=32
CONFIG_BT_GATT_DYNAMIC_DB=y
CONFIG_WIFI_NRF70=y
CONFIG_WIFI_NM=y
CONFIG_WIFI_NM_WPA_SUPPLICANT=y

# Net buffers (nRF700x needs more)
CONFIG_NET_PKT_RX_COUNT=16
CONFIG_NET_PKT_TX_COUNT=16
CONFIG_NET_BUF_RX_COUNT=32
CONFIG_NET_BUF_TX_COUNT=32
CONFIG_NET_MAX_CONN=4
CONFIG_NET_MAX_CONTEXTS=8
```

## src/main.c
```c
#include <zephyr/kernel.h>
#include <zephyr/logging/log.h>

#include <wifi_prov/wifi_prov.h>
#include "throughput_server.h"

LOG_MODULE_REGISTER(app, LOG_LEVEL_INF);

int main(void)
{
	int ret;

	LOG_INF("WiFi Provisioning App");

	ret = wifi_prov_init();
	if (ret) {
		LOG_ERR("wifi_prov_init failed: %d", ret);
		return ret;
	}

	ret = wifi_prov_start();
	if (ret) {
		LOG_ERR("wifi_prov_start failed: %d", ret);
		return ret;
	}

	throughput_server_start();

	return 0;
}
```

## src/throughput_server.c
```c
#include <zephyr/kernel.h>
#include <zephyr/logging/log.h>
#include <zephyr/net/socket.h>

#include "throughput_server.h"

LOG_MODULE_REGISTER(throughput, LOG_LEVEL_INF);

#ifndef CONFIG_THROUGHPUT_PORT
#define CONFIG_THROUGHPUT_PORT 4242
#endif

#define STACK_SIZE 8192
#define THREAD_PRIORITY 7
#define BUF_SIZE 1024

#define CMD_ECHO   0x01
#define CMD_SINK   0x02
#define CMD_SOURCE 0x03

static void handle_client(int client_fd)
{
	uint8_t buf[BUF_SIZE];
	int ret;

	/* Read 1-byte command */
	ret = zsock_recv(client_fd, buf, 1, 0);
	if (ret != 1) {
		LOG_ERR("Failed to read command");
		return;
	}

	uint8_t cmd = buf[0];
	int64_t start = k_uptime_get();
	int64_t last_report = start;
	size_t interval_bytes = 0;
	size_t total_bytes = 0;

	LOG_INF("Client mode: 0x%02x", cmd);

	while (true) {
		int64_t now = k_uptime_get();

		/* Per-second stats */
		if (now - last_report >= 1000) {
			int64_t dt_ms = now - last_report;
			uint32_t kbps = (interval_bytes * 8) / (uint32_t)dt_ms;

			LOG_INF("Throughput: %u Kbps (%zu bytes in %lld ms)",
				kbps, interval_bytes, dt_ms);
			last_report = now;
			interval_bytes = 0;
		}

		switch (cmd) {
		case CMD_ECHO:
			ret = zsock_recv(client_fd, buf, sizeof(buf), 0);
			if (ret <= 0) {
				goto done;
			}
			interval_bytes += ret;
			total_bytes += ret;
			ret = zsock_send(client_fd, buf, ret, 0);
			if (ret < 0) {
				goto done;
			}
			break;

		case CMD_SINK:
			ret = zsock_recv(client_fd, buf, sizeof(buf), 0);
			if (ret <= 0) {
				goto done;
			}
			interval_bytes += ret;
			total_bytes += ret;
			break;

		case CMD_SOURCE:
			memset(buf, 0xAA, sizeof(buf));
			ret = zsock_send(client_fd, buf, sizeof(buf), 0);
			if (ret < 0) {
				goto done;
			}
			interval_bytes += ret;
			total_bytes += ret;
			break;

		default:
			LOG_ERR("Unknown command: 0x%02x", cmd);
			goto done;
		}
	}

done:;
	int64_t elapsed_ms = k_uptime_get() - start;

	if (elapsed_ms > 0) {
		uint32_t avg_kbps = (total_bytes * 8) / (uint32_t)elapsed_ms;

		LOG_INF("Session done: %zu bytes in %lld ms (%u Kbps avg)",
			total_bytes, elapsed_ms, avg_kbps);
	}
}

static void throughput_thread(void *p1, void *p2, void *p3)
{
	ARG_UNUSED(p1);
	ARG_UNUSED(p2);
	ARG_UNUSED(p3);

	int server_fd;
	struct sockaddr_in addr = {
		.sin_family = AF_INET,
		.sin_port = htons(CONFIG_THROUGHPUT_PORT),
		.sin_addr.s_addr = htonl(INADDR_ANY),
	};

	server_fd = zsock_socket(AF_INET, SOCK_STREAM, IPPROTO_TCP);
	if (server_fd < 0) {
		LOG_ERR("Socket create failed: %d", errno);
		return;
	}

	int opt = 1;

	zsock_setsockopt(server_fd, SOL_SOCKET, SO_REUSEADDR, &opt, sizeof(opt));

	if (zsock_bind(server_fd, (struct sockaddr *)&addr, sizeof(addr)) < 0) {
		LOG_ERR("Bind failed: %d", errno);
		zsock_close(server_fd);
		return;
	}

	if (zsock_listen(server_fd, 1) < 0) {
		LOG_ERR("Listen failed: %d", errno);
		zsock_close(server_fd);
		return;
	}

	LOG_INF("Throughput server listening on port %d", CONFIG_THROUGHPUT_PORT);

	while (true) {
		struct sockaddr_in client_addr;
		socklen_t client_len = sizeof(client_addr);

		int client_fd = zsock_accept(server_fd,
					     (struct sockaddr *)&client_addr,
					     &client_len);
		if (client_fd < 0) {
			LOG_ERR("Accept failed: %d", errno);
			continue;
		}

		LOG_INF("Client connected");
		handle_client(client_fd);
		zsock_close(client_fd);
		LOG_INF("Client disconnected");
	}
}

K_THREAD_STACK_DEFINE(throughput_stack, STACK_SIZE);
static struct k_thread throughput_thread_data;

void throughput_server_start(void)
{
	k_thread_create(&throughput_thread_data, throughput_stack,
			STACK_SIZE, throughput_thread,
			NULL, NULL, NULL,
			THREAD_PRIORITY, 0, K_NO_WAIT);
	k_thread_name_set(&throughput_thread_data, "throughput");
	LOG_INF("Throughput server thread started");
}
```

## src/throughput_server.h
```c
#ifndef THROUGHPUT_SERVER_H
#define THROUGHPUT_SERVER_H

/**
 * @brief Start the TCP throughput server thread.
 *
 * Listens on CONFIG_THROUGHPUT_PORT (default 4242).
 * Supports three modes:
 *   0x01 = echo: read and echo back
 *   0x02 = sink: read and discard
 *   0x03 = source: write continuously
 *
 * Runs in its own thread, call once after WiFi is connected.
 */
void throughput_server_start(void);

#endif /* THROUGHPUT_SERVER_H */
```
