## CMakeLists.txt
```
# SPDX-License-Identifier: Apache-2.0

cmake_minimum_required(VERSION 3.20.0)

find_package(Zephyr REQUIRED HINTS $ENV{ZEPHYR_BASE})
project(ble_wifi_bridge)

target_sources(app PRIVATE
    src/main.c
    src/ble_nus.c
    src/wifi_manager.c
    src/tcp_socket.c
    src/bridge.c
)

target_include_directories(app PRIVATE src)
```

## Kconfig
```
# Kconfig for BLE WiFi Bridge

menu "BLE WiFi Bridge Configuration"

config BRIDGE_WIFI_SSID
    string "WiFi SSID"
    default "MyNetwork"
    help
      WiFi network SSID to connect to.

config BRIDGE_WIFI_PSK
    string "WiFi Password"
    default "password123"
    help
      WiFi network password.

config BRIDGE_TCP_SERVER_ADDR
    string "TCP Server Address"
    default "192.168.1.100"
    help
      IP address of the TCP server to connect to.

config BRIDGE_TCP_SERVER_PORT
    int "TCP Server Port"
    default 4242
    help
      Port number of the TCP server.

config BRIDGE_QUEUE_SIZE
    int "Bridge Message Queue Size"
    default 8
    help
      Number of messages that can be queued between BLE and WiFi.

config BRIDGE_MSG_MAX_SIZE
    int "Maximum Message Size"
    default 256
    help
      Maximum size of a single message in bytes.

endmenu

source "Kconfig.zephyr"
```

## prj.conf
```kconfig
# ESP32 chip revision compatibility
CONFIG_ESP32_USE_UNSUPPORTED_REVISION=y

# Bluetooth
CONFIG_BT=y
CONFIG_BT_PERIPHERAL=y
CONFIG_BT_DEVICE_NAME="BLE WiFi Bridge"
CONFIG_BT_ZEPHYR_NUS=y
CONFIG_BT_MAX_CONN=1
CONFIG_BT_DEVICE_APPEARANCE=833

# WiFi - driver enabled automatically via devicetree
CONFIG_WIFI=y

# Networking
CONFIG_NETWORKING=y
CONFIG_NET_IPV4=y
CONFIG_NET_TCP=y
CONFIG_NET_SOCKETS=y
CONFIG_NET_DHCPV4=y
CONFIG_NET_L2_ETHERNET=y

# Network management
CONFIG_NET_MGMT=y
CONFIG_NET_MGMT_EVENT=y
CONFIG_NET_MGMT_EVENT_INFO=y
CONFIG_NET_L2_WIFI_MGMT=y
CONFIG_NET_CONNECTION_MANAGER=y

# POSIX networking for socket API
CONFIG_POSIX_API=y

# Socket configuration
CONFIG_NET_MAX_CONN=4
CONFIG_NET_MAX_CONTEXTS=8
CONFIG_NET_PKT_RX_COUNT=16
CONFIG_NET_PKT_TX_COUNT=16
CONFIG_NET_BUF_RX_COUNT=32
CONFIG_NET_BUF_TX_COUNT=32

# Logging
CONFIG_LOG=y
CONFIG_LOG_DEFAULT_LEVEL=3
CONFIG_NET_LOG=y

# Stack sizes (ESP32 needs larger stacks)
CONFIG_MAIN_STACK_SIZE=4096
CONFIG_SYSTEM_WORKQUEUE_STACK_SIZE=4096
CONFIG_NET_MGMT_EVENT_STACK_SIZE=2048

# Heap for networking
CONFIG_HEAP_MEM_POOL_SIZE=8192

# Bridge configuration defaults
CONFIG_BRIDGE_WIFI_SSID="dan_and_mich"
CONFIG_BRIDGE_WIFI_PSK="m1ch3ll3"
CONFIG_BRIDGE_TCP_SERVER_ADDR="192.168.1.200"
CONFIG_BRIDGE_TCP_SERVER_PORT=4242
```

## src/main.c
```c
/*
 * BLE WiFi Bridge Application
 *
 * Bridges data between BLE NUS and WiFi TCP socket.
 * Target: ESP32-C3 DevKitC
 */

#include <zephyr/kernel.h>
#include <zephyr/logging/log.h>

#include "ble_nus.h"
#include "wifi_manager.h"
#include "tcp_socket.h"
#include "bridge.h"

LOG_MODULE_REGISTER(main, LOG_LEVEL_INF);

/* Semaphore to signal WiFi is ready */
K_SEM_DEFINE(wifi_ready_sem, 0, 1);

/* Callback for BLE data received - queue for TCP */
static void on_ble_rx(const uint8_t *data, uint16_t len)
{
	bridge_queue_ble_to_tcp(data, len);
}

/* Callback for TCP data received - queue for BLE */
static void on_tcp_rx(const uint8_t *data, uint16_t len)
{
	bridge_queue_tcp_to_ble(data, len);
}

/* Callback for WiFi state changes */
static void on_wifi_state(bool connected)
{
	if (connected) {
		LOG_INF("WiFi ready with IP address");
		k_sem_give(&wifi_ready_sem);
	} else {
		LOG_WRN("WiFi connection lost");
		bridge_stop();
		tcp_socket_disconnect();
	}
}

int main(void)
{
	int ret;

	LOG_INF("BLE WiFi Bridge starting");

	/* Initialize bridge module */
	ret = bridge_init();
	if (ret) {
		LOG_ERR("Bridge init failed: %d", ret);
		return ret;
	}

	/* Initialize BLE NUS */
	ret = ble_nus_init(on_ble_rx);
	if (ret) {
		LOG_ERR("BLE NUS init failed: %d", ret);
		return ret;
	}

	/* Start BLE advertising */
	ret = ble_nus_start_advertising();
	if (ret) {
		LOG_ERR("BLE advertising failed: %d", ret);
		return ret;
	}

	/* Initialize WiFi manager */
	ret = wifi_manager_init(on_wifi_state);
	if (ret) {
		LOG_ERR("WiFi manager init failed: %d", ret);
		return ret;
	}

	/* Initialize TCP socket */
	ret = tcp_socket_init(on_tcp_rx);
	if (ret) {
		LOG_ERR("TCP socket init failed: %d", ret);
		return ret;
	}

	LOG_INF("All modules initialized");
	LOG_INF("Connecting to WiFi...");

	/* Connect to WiFi */
	ret = wifi_manager_connect();
	if (ret) {
		LOG_ERR("WiFi connect failed: %d", ret);
		LOG_INF("Continuing with BLE only mode");
	} else {
		/* Wait for IP address */
		ret = k_sem_take(&wifi_ready_sem, K_SECONDS(30));
		if (ret) {
			LOG_WRN("Timeout waiting for IP address");
		} else {
			/* Connect to TCP server */
			ret = tcp_socket_connect();
			if (ret) {
				LOG_ERR("TCP connect failed: %d", ret);
				LOG_INF("Continuing with BLE only mode");
			} else {
				/* Start TCP receive thread */
				tcp_socket_start_rx();

				/* Start the bridge */
				bridge_start();

				LOG_INF("Bridge active: BLE <-> TCP");
			}
		}
	}

	/* Main loop - monitor and reconnect as needed */
	while (1) {
		k_sleep(K_SECONDS(5));

		/* Log status periodically */
		LOG_INF("Status: BLE=%s, WiFi=%s, TCP=%s",
			ble_nus_is_connected() ? "connected" : "advertising",
			wifi_manager_is_connected() ? "connected" : "disconnected",
			tcp_socket_is_connected() ? "connected" : "disconnected");

		/* If WiFi connected but TCP not, try to reconnect */
		if (wifi_manager_is_connected() && !tcp_socket_is_connected()) {
			LOG_INF("Attempting TCP reconnection...");
			ret = tcp_socket_connect();
			if (ret == 0) {
				tcp_socket_start_rx();
				bridge_start();
				LOG_INF("TCP reconnected");
			}
		}
	}

	return 0;
}
```

## src/ble_nus.c
```c
/*
 * BLE NUS Module Implementation
 */

#include <zephyr/kernel.h>
#include <zephyr/logging/log.h>
#include <zephyr/bluetooth/bluetooth.h>
#include <zephyr/bluetooth/conn.h>
#include <zephyr/bluetooth/uuid.h>
#include <zephyr/bluetooth/services/nus.h>

#include "ble_nus.h"

LOG_MODULE_REGISTER(ble_nus, LOG_LEVEL_INF);

#define DEVICE_NAME CONFIG_BT_DEVICE_NAME
#define DEVICE_NAME_LEN (sizeof(DEVICE_NAME) - 1)

static struct bt_conn *current_conn;
static ble_nus_rx_cb_t rx_callback;

/* Advertising data */
static const struct bt_data ad[] = {
	BT_DATA_BYTES(BT_DATA_FLAGS, (BT_LE_AD_GENERAL | BT_LE_AD_NO_BREDR)),
	BT_DATA(BT_DATA_NAME_COMPLETE, DEVICE_NAME, DEVICE_NAME_LEN),
};

/* Scan response data */
static const struct bt_data sd[] = {
	BT_DATA_BYTES(BT_DATA_UUID128_ALL, BT_UUID_NUS_SRV_VAL),
};

static void nus_notif_enabled(bool enabled, void *ctx)
{
	ARG_UNUSED(ctx);
	LOG_INF("NUS notifications %s", enabled ? "enabled" : "disabled");
}

static void nus_received(struct bt_conn *conn, const void *data, uint16_t len,
			 void *ctx)
{
	ARG_UNUSED(conn);
	ARG_UNUSED(ctx);

	LOG_INF("BLE RX: %u bytes", len);

	if (rx_callback) {
		rx_callback((const uint8_t *)data, len);
	}
}

static struct bt_nus_cb nus_callbacks = {
	.notif_enabled = nus_notif_enabled,
	.received = nus_received,
};

static void connected(struct bt_conn *conn, uint8_t err)
{
	char addr[BT_ADDR_LE_STR_LEN];

	bt_addr_le_to_str(bt_conn_get_dst(conn), addr, sizeof(addr));

	if (err) {
		LOG_ERR("BLE connection failed: %s (err %u)", addr, err);
		return;
	}

	LOG_INF("BLE connected: %s", addr);
	current_conn = bt_conn_ref(conn);
}

static void disconnected(struct bt_conn *conn, uint8_t reason)
{
	char addr[BT_ADDR_LE_STR_LEN];

	bt_addr_le_to_str(bt_conn_get_dst(conn), addr, sizeof(addr));
	LOG_INF("BLE disconnected: %s (reason 0x%02x)", addr, reason);

	if (current_conn) {
		bt_conn_unref(current_conn);
		current_conn = NULL;
	}

	/* Restart advertising */
	int ret = bt_le_adv_start(BT_LE_ADV_CONN_FAST_1, ad, ARRAY_SIZE(ad),
				  sd, ARRAY_SIZE(sd));
	if (ret) {
		LOG_ERR("Failed to restart advertising (err %d)", ret);
	}
}

BT_CONN_CB_DEFINE(conn_callbacks) = {
	.connected = connected,
	.disconnected = disconnected,
};

int ble_nus_init(ble_nus_rx_cb_t callback)
{
	int err;

	rx_callback = callback;

	err = bt_nus_cb_register(&nus_callbacks, NULL);
	if (err) {
		LOG_ERR("Failed to register NUS callbacks (err %d)", err);
		return err;
	}

	err = bt_enable(NULL);
	if (err) {
		LOG_ERR("Bluetooth init failed (err %d)", err);
		return err;
	}

	LOG_INF("BLE NUS initialized");
	return 0;
}

int ble_nus_start_advertising(void)
{
	int err = bt_le_adv_start(BT_LE_ADV_CONN_FAST_1, ad, ARRAY_SIZE(ad),
				  sd, ARRAY_SIZE(sd));
	if (err) {
		LOG_ERR("Advertising failed to start (err %d)", err);
		return err;
	}

	LOG_INF("BLE advertising started as \"%s\"", DEVICE_NAME);
	return 0;
}

int ble_nus_send(const uint8_t *data, uint16_t len)
{
	if (!current_conn) {
		return -ENOTCONN;
	}

	int ret = bt_nus_send(current_conn, data, len);
	if (ret < 0) {
		LOG_ERR("BLE TX failed: %d", ret);
	} else {
		LOG_DBG("BLE TX: %d bytes", ret);
	}

	return ret;
}

bool ble_nus_is_connected(void)
{
	return current_conn != NULL;
}
```

## src/ble_nus.h
```c
/*
 * BLE NUS Module Header
 */

#ifndef BLE_NUS_H
#define BLE_NUS_H

#include <zephyr/kernel.h>
#include <stdbool.h>

/* Callback type for received BLE data */
typedef void (*ble_nus_rx_cb_t)(const uint8_t *data, uint16_t len);

/**
 * @brief Initialize BLE NUS module
 *
 * @param rx_callback Callback function for received data
 * @return 0 on success, negative errno on failure
 */
int ble_nus_init(ble_nus_rx_cb_t rx_callback);

/**
 * @brief Start BLE advertising
 *
 * @return 0 on success, negative errno on failure
 */
int ble_nus_start_advertising(void);

/**
 * @brief Send data over BLE NUS
 *
 * @param data Data to send
 * @param len Length of data
 * @return Number of bytes sent on success, negative errno on failure
 */
int ble_nus_send(const uint8_t *data, uint16_t len);

/**
 * @brief Check if BLE is connected
 *
 * @return true if connected, false otherwise
 */
bool ble_nus_is_connected(void);

#endif /* BLE_NUS_H */
```

## src/bridge.c
```c
/*
 * Bridge Module Implementation
 *
 * Uses message queues to buffer data between BLE and TCP.
 */

#include <zephyr/kernel.h>
#include <zephyr/logging/log.h>
#include <string.h>

#include "bridge.h"
#include "ble_nus.h"
#include "tcp_socket.h"

LOG_MODULE_REGISTER(bridge, LOG_LEVEL_INF);

#define BRIDGE_THREAD_STACK_SIZE 2048
#define BRIDGE_THREAD_PRIORITY 6

/* Message structure for queued data */
struct bridge_msg {
	uint8_t data[CONFIG_BRIDGE_MSG_MAX_SIZE];
	uint16_t len;
};

/* Message queues */
K_MSGQ_DEFINE(ble_to_tcp_queue, sizeof(struct bridge_msg),
	      CONFIG_BRIDGE_QUEUE_SIZE, 4);
K_MSGQ_DEFINE(tcp_to_ble_queue, sizeof(struct bridge_msg),
	      CONFIG_BRIDGE_QUEUE_SIZE, 4);

static bool bridge_running;

K_THREAD_STACK_DEFINE(bridge_stack, BRIDGE_THREAD_STACK_SIZE);
static struct k_thread bridge_thread;

/* Process BLE to TCP queue */
static void process_ble_to_tcp(void)
{
	struct bridge_msg msg;

	while (k_msgq_get(&ble_to_tcp_queue, &msg, K_NO_WAIT) == 0) {
		if (tcp_socket_is_connected()) {
			int ret = tcp_socket_send(msg.data, msg.len);
			if (ret < 0) {
				LOG_ERR("Failed to send to TCP: %d", ret);
			} else {
				LOG_INF("Bridge: BLE->TCP %d bytes", msg.len);
			}
		} else {
			LOG_WRN("TCP not connected, dropping message");
		}
	}
}

/* Process TCP to BLE queue */
static void process_tcp_to_ble(void)
{
	struct bridge_msg msg;

	while (k_msgq_get(&tcp_to_ble_queue, &msg, K_NO_WAIT) == 0) {
		if (ble_nus_is_connected()) {
			int ret = ble_nus_send(msg.data, msg.len);
			if (ret < 0) {
				LOG_ERR("Failed to send to BLE: %d", ret);
			} else {
				LOG_INF("Bridge: TCP->BLE %d bytes", msg.len);
			}
		} else {
			LOG_WRN("BLE not connected, dropping message");
		}
	}
}

/* Bridge thread function */
static void bridge_thread_fn(void *p1, void *p2, void *p3)
{
	ARG_UNUSED(p1);
	ARG_UNUSED(p2);
	ARG_UNUSED(p3);

	LOG_INF("Bridge thread started");

	while (bridge_running) {
		process_ble_to_tcp();
		process_tcp_to_ble();

		/* Small sleep to avoid busy-waiting */
		k_sleep(K_MSEC(10));
	}

	LOG_INF("Bridge thread exiting");
}

int bridge_init(void)
{
	/* Clear any stale messages */
	k_msgq_purge(&ble_to_tcp_queue);
	k_msgq_purge(&tcp_to_ble_queue);

	LOG_INF("Bridge module initialized");
	return 0;
}

void bridge_start(void)
{
	if (bridge_running) {
		LOG_WRN("Bridge already running");
		return;
	}

	bridge_running = true;

	k_thread_create(&bridge_thread, bridge_stack,
			K_THREAD_STACK_SIZEOF(bridge_stack),
			bridge_thread_fn, NULL, NULL, NULL,
			BRIDGE_THREAD_PRIORITY, 0, K_NO_WAIT);

	k_thread_name_set(&bridge_thread, "bridge");

	LOG_INF("Bridge started");
}

void bridge_stop(void)
{
	bridge_running = false;
	LOG_INF("Bridge stopped");
}

int bridge_queue_ble_to_tcp(const uint8_t *data, uint16_t len)
{
	struct bridge_msg msg;

	if (len > CONFIG_BRIDGE_MSG_MAX_SIZE) {
		LOG_ERR("Message too large: %u > %u", len, CONFIG_BRIDGE_MSG_MAX_SIZE);
		return -EMSGSIZE;
	}

	memcpy(msg.data, data, len);
	msg.len = len;

	int ret = k_msgq_put(&ble_to_tcp_queue, &msg, K_NO_WAIT);
	if (ret) {
		LOG_WRN("BLE->TCP queue full, dropping message");
		return -ENOMEM;
	}

	return 0;
}

int bridge_queue_tcp_to_ble(const uint8_t *data, uint16_t len)
{
	struct bridge_msg msg;

	if (len > CONFIG_BRIDGE_MSG_MAX_SIZE) {
		LOG_ERR("Message too large: %u > %u", len, CONFIG_BRIDGE_MSG_MAX_SIZE);
		return -EMSGSIZE;
	}

	memcpy(msg.data, data, len);
	msg.len = len;

	int ret = k_msgq_put(&tcp_to_ble_queue, &msg, K_NO_WAIT);
	if (ret) {
		LOG_WRN("TCP->BLE queue full, dropping message");
		return -ENOMEM;
	}

	return 0;
}
```

## src/bridge.h
```c
/*
 * Bridge Module Header
 *
 * Handles bidirectional data transfer between BLE and TCP.
 */

#ifndef BRIDGE_H
#define BRIDGE_H

#include <zephyr/kernel.h>

/**
 * @brief Initialize the bridge module
 *
 * Sets up message queues and callbacks for BLE/TCP bridging.
 *
 * @return 0 on success, negative errno on failure
 */
int bridge_init(void);

/**
 * @brief Start the bridge processing
 *
 * Begins forwarding data between BLE and TCP.
 * Should be called after both BLE and TCP are connected.
 */
void bridge_start(void);

/**
 * @brief Stop the bridge processing
 */
void bridge_stop(void);

/**
 * @brief Queue data received from BLE to be sent to TCP
 *
 * @param data Data buffer
 * @param len Data length
 * @return 0 on success, negative errno on failure
 */
int bridge_queue_ble_to_tcp(const uint8_t *data, uint16_t len);

/**
 * @brief Queue data received from TCP to be sent to BLE
 *
 * @param data Data buffer
 * @param len Data length
 * @return 0 on success, negative errno on failure
 */
int bridge_queue_tcp_to_ble(const uint8_t *data, uint16_t len);

#endif /* BRIDGE_H */
```

## src/tcp_socket.c
```c
/*
 * TCP Socket Implementation
 */

#include <zephyr/kernel.h>
#include <zephyr/logging/log.h>
#include <zephyr/net/socket.h>

#include "tcp_socket.h"

LOG_MODULE_REGISTER(tcp_socket, LOG_LEVEL_INF);

#define TCP_RX_THREAD_STACK_SIZE 2048
#define TCP_RX_THREAD_PRIORITY 7
#define TCP_RX_BUFFER_SIZE CONFIG_BRIDGE_MSG_MAX_SIZE

static int sock_fd = -1;
static tcp_rx_cb_t rx_callback;
static bool connected;
static bool rx_thread_running;

K_THREAD_STACK_DEFINE(tcp_rx_stack, TCP_RX_THREAD_STACK_SIZE);
static struct k_thread tcp_rx_thread;

static void tcp_rx_thread_fn(void *p1, void *p2, void *p3)
{
	ARG_UNUSED(p1);
	ARG_UNUSED(p2);
	ARG_UNUSED(p3);

	uint8_t buffer[TCP_RX_BUFFER_SIZE];

	LOG_INF("TCP RX thread started");

	while (connected && sock_fd >= 0) {
		int len = recv(sock_fd, buffer, sizeof(buffer), 0);

		if (len < 0) {
			if (errno == EAGAIN || errno == EWOULDBLOCK) {
				continue;
			}
			LOG_ERR("TCP recv error: %d", errno);
			break;
		}

		if (len == 0) {
			LOG_INF("TCP connection closed by server");
			break;
		}

		LOG_INF("TCP RX: %d bytes", len);

		if (rx_callback) {
			rx_callback(buffer, len);
		}
	}

	LOG_INF("TCP RX thread exiting");
	connected = false;
	rx_thread_running = false;
}

int tcp_socket_init(tcp_rx_cb_t callback)
{
	rx_callback = callback;
	LOG_INF("TCP socket module initialized");
	return 0;
}

int tcp_socket_connect(void)
{
	struct sockaddr_in server_addr;
	int ret;

	if (sock_fd >= 0) {
		LOG_WRN("TCP socket already exists");
		return -EALREADY;
	}

	/* Create socket */
	sock_fd = socket(AF_INET, SOCK_STREAM, IPPROTO_TCP);
	if (sock_fd < 0) {
		LOG_ERR("Failed to create socket: %d", errno);
		return -errno;
	}

	/* Set up server address */
	memset(&server_addr, 0, sizeof(server_addr));
	server_addr.sin_family = AF_INET;
	server_addr.sin_port = htons(CONFIG_BRIDGE_TCP_SERVER_PORT);

	ret = inet_pton(AF_INET, CONFIG_BRIDGE_TCP_SERVER_ADDR,
			&server_addr.sin_addr);
	if (ret != 1) {
		LOG_ERR("Invalid server address: %s", CONFIG_BRIDGE_TCP_SERVER_ADDR);
		close(sock_fd);
		sock_fd = -1;
		return -EINVAL;
	}

	LOG_INF("Connecting to %s:%d",
		CONFIG_BRIDGE_TCP_SERVER_ADDR, CONFIG_BRIDGE_TCP_SERVER_PORT);

	/* Connect to server */
	ret = connect(sock_fd, (struct sockaddr *)&server_addr,
		      sizeof(server_addr));
	if (ret < 0) {
		LOG_ERR("TCP connect failed: %d", errno);
		close(sock_fd);
		sock_fd = -1;
		return -errno;
	}

	connected = true;
	LOG_INF("TCP connected to %s:%d",
		CONFIG_BRIDGE_TCP_SERVER_ADDR, CONFIG_BRIDGE_TCP_SERVER_PORT);

	return 0;
}

void tcp_socket_disconnect(void)
{
	connected = false;

	if (sock_fd >= 0) {
		close(sock_fd);
		sock_fd = -1;
	}

	LOG_INF("TCP socket disconnected");
}

int tcp_socket_send(const uint8_t *data, uint16_t len)
{
	if (!connected || sock_fd < 0) {
		return -ENOTCONN;
	}

	int sent = send(sock_fd, data, len, 0);
	if (sent < 0) {
		LOG_ERR("TCP send failed: %d", errno);
		return -errno;
	}

	LOG_DBG("TCP TX: %d bytes", sent);
	return sent;
}

bool tcp_socket_is_connected(void)
{
	return connected && sock_fd >= 0;
}

void tcp_socket_start_rx(void)
{
	if (rx_thread_running) {
		LOG_WRN("TCP RX thread already running");
		return;
	}

	rx_thread_running = true;

	k_thread_create(&tcp_rx_thread, tcp_rx_stack,
			K_THREAD_STACK_SIZEOF(tcp_rx_stack),
			tcp_rx_thread_fn, NULL, NULL, NULL,
			TCP_RX_THREAD_PRIORITY, 0, K_NO_WAIT);

	k_thread_name_set(&tcp_rx_thread, "tcp_rx");
}
```

## src/tcp_socket.h
```c
/*
 * TCP Socket Header
 */

#ifndef TCP_SOCKET_H
#define TCP_SOCKET_H

#include <zephyr/kernel.h>
#include <stdbool.h>

/* Callback type for received TCP data */
typedef void (*tcp_rx_cb_t)(const uint8_t *data, uint16_t len);

/**
 * @brief Initialize TCP socket module
 *
 * @param rx_callback Callback function for received data
 * @return 0 on success, negative errno on failure
 */
int tcp_socket_init(tcp_rx_cb_t rx_callback);

/**
 * @brief Connect to TCP server
 *
 * @return 0 on success, negative errno on failure
 */
int tcp_socket_connect(void);

/**
 * @brief Disconnect from TCP server
 */
void tcp_socket_disconnect(void);

/**
 * @brief Send data over TCP socket
 *
 * @param data Data to send
 * @param len Length of data
 * @return Number of bytes sent on success, negative errno on failure
 */
int tcp_socket_send(const uint8_t *data, uint16_t len);

/**
 * @brief Check if TCP socket is connected
 *
 * @return true if connected, false otherwise
 */
bool tcp_socket_is_connected(void);

/**
 * @brief Start TCP receive thread
 *
 * Must be called after connect succeeds.
 */
void tcp_socket_start_rx(void);

#endif /* TCP_SOCKET_H */
```

## src/wifi_manager.c
```c
/*
 * WiFi Manager Implementation
 */

#include <zephyr/kernel.h>
#include <zephyr/logging/log.h>
#include <zephyr/net/net_if.h>
#include <zephyr/net/net_mgmt.h>
#include <zephyr/net/wifi_mgmt.h>
#include <zephyr/net/dhcpv4.h>

#include "wifi_manager.h"

LOG_MODULE_REGISTER(wifi_manager, LOG_LEVEL_INF);

static struct net_mgmt_event_callback wifi_cb;
static struct net_mgmt_event_callback ipv4_cb;
static wifi_state_cb_t state_callback;
static bool wifi_connected;
static bool ip_obtained;
static struct net_if *wifi_iface;

K_SEM_DEFINE(wifi_connect_sem, 0, 1);

static void handle_wifi_connect_result(struct net_mgmt_event_callback *cb)
{
	const struct wifi_status *status = (const struct wifi_status *)cb->info;

	if (status->status) {
		LOG_ERR("WiFi connection failed: %d", status->status);
		wifi_connected = false;
	} else {
		LOG_INF("WiFi connected");
		wifi_connected = true;
	}

	k_sem_give(&wifi_connect_sem);
}

static void handle_wifi_disconnect_result(struct net_mgmt_event_callback *cb)
{
	const struct wifi_status *status = (const struct wifi_status *)cb->info;

	if (status->status) {
		LOG_WRN("WiFi disconnect status: %d", status->status);
	}

	LOG_INF("WiFi disconnected");
	wifi_connected = false;
	ip_obtained = false;

	if (state_callback) {
		state_callback(false);
	}
}

static void wifi_mgmt_event_handler(struct net_mgmt_event_callback *cb,
				    uint64_t mgmt_event, struct net_if *iface)
{
	switch (mgmt_event) {
	case NET_EVENT_WIFI_CONNECT_RESULT:
		handle_wifi_connect_result(cb);
		break;
	case NET_EVENT_WIFI_DISCONNECT_RESULT:
		handle_wifi_disconnect_result(cb);
		break;
	default:
		break;
	}
}

static void ipv4_mgmt_event_handler(struct net_mgmt_event_callback *cb,
				    uint64_t mgmt_event, struct net_if *iface)
{
	if (mgmt_event == NET_EVENT_IPV4_ADDR_ADD) {
		char addr_str[NET_IPV4_ADDR_LEN];
		struct net_if_ipv4 *ipv4 = iface->config.ip.ipv4;

		if (ipv4 && ipv4->unicast[0].ipv4.is_used) {
			struct in_addr *addr = &ipv4->unicast[0].ipv4.address.in_addr;
			net_addr_ntop(AF_INET, addr, addr_str, sizeof(addr_str));
			LOG_INF("IPv4 address: %s", addr_str);
		}

		ip_obtained = true;

		if (state_callback) {
			state_callback(true);
		}
	}
}

int wifi_manager_init(wifi_state_cb_t callback)
{
	state_callback = callback;

	/* Get WiFi interface */
	wifi_iface = net_if_get_default();
	if (!wifi_iface) {
		LOG_ERR("No default network interface");
		return -ENODEV;
	}

	/* Register WiFi management events */
	net_mgmt_init_event_callback(&wifi_cb, wifi_mgmt_event_handler,
				     NET_EVENT_WIFI_CONNECT_RESULT |
				     NET_EVENT_WIFI_DISCONNECT_RESULT);
	net_mgmt_add_event_callback(&wifi_cb);

	/* Register IPv4 events */
	net_mgmt_init_event_callback(&ipv4_cb, ipv4_mgmt_event_handler,
				     NET_EVENT_IPV4_ADDR_ADD);
	net_mgmt_add_event_callback(&ipv4_cb);

	LOG_INF("WiFi manager initialized");
	return 0;
}

int wifi_manager_connect(void)
{
	struct wifi_connect_req_params params = {0};

	params.ssid = (const uint8_t *)CONFIG_BRIDGE_WIFI_SSID;
	params.ssid_length = strlen(CONFIG_BRIDGE_WIFI_SSID);
	params.psk = (const uint8_t *)CONFIG_BRIDGE_WIFI_PSK;
	params.psk_length = strlen(CONFIG_BRIDGE_WIFI_PSK);
	params.channel = WIFI_CHANNEL_ANY;
	params.band = WIFI_FREQ_BAND_2_4_GHZ;

	if (params.psk_length > 0) {
		params.security = WIFI_SECURITY_TYPE_PSK;
	} else {
		params.security = WIFI_SECURITY_TYPE_NONE;
	}

	LOG_INF("Connecting to WiFi SSID: %s", CONFIG_BRIDGE_WIFI_SSID);

	int ret = net_mgmt(NET_REQUEST_WIFI_CONNECT, wifi_iface,
			   &params, sizeof(params));
	if (ret) {
		LOG_ERR("WiFi connect request failed: %d", ret);
		return ret;
	}

	/* Wait for connection result */
	ret = k_sem_take(&wifi_connect_sem, K_SECONDS(30));
	if (ret) {
		LOG_ERR("WiFi connection timeout");
		return -ETIMEDOUT;
	}

	if (!wifi_connected) {
		return -ECONNREFUSED;
	}

	/* Start DHCP if not already configured */
	net_dhcpv4_start(wifi_iface);

	return 0;
}

int wifi_manager_disconnect(void)
{
	int ret = net_mgmt(NET_REQUEST_WIFI_DISCONNECT, wifi_iface, NULL, 0);
	if (ret) {
		LOG_ERR("WiFi disconnect request failed: %d", ret);
		return ret;
	}

	return 0;
}

bool wifi_manager_is_connected(void)
{
	return wifi_connected && ip_obtained;
}
```

## src/wifi_manager.h
```c
/*
 * WiFi Manager Header
 */

#ifndef WIFI_MANAGER_H
#define WIFI_MANAGER_H

#include <zephyr/kernel.h>
#include <stdbool.h>

/* Callback type for WiFi connection state changes */
typedef void (*wifi_state_cb_t)(bool connected);

/**
 * @brief Initialize WiFi manager
 *
 * @param state_callback Callback for connection state changes
 * @return 0 on success, negative errno on failure
 */
int wifi_manager_init(wifi_state_cb_t state_callback);

/**
 * @brief Connect to configured WiFi network
 *
 * @return 0 on success, negative errno on failure
 */
int wifi_manager_connect(void);

/**
 * @brief Disconnect from WiFi network
 *
 * @return 0 on success, negative errno on failure
 */
int wifi_manager_disconnect(void);

/**
 * @brief Check if WiFi is connected
 *
 * @return true if connected, false otherwise
 */
bool wifi_manager_is_connected(void);

#endif /* WIFI_MANAGER_H */
```
