## apps/hello_world/boards/nrf5340dk_nrf5340_cpuapp.conf
```kconfig
# RTT logging for hardware-in-the-loop CI (probe-rs reads RTT, not UART)
CONFIG_LOG_BACKEND_RTT=y
CONFIG_LOG_BACKEND_UART=n
CONFIG_USE_SEGGER_RTT=y
```

## esp-idf/wifi_provision/sdkconfig.defaults
```kconfig
# NimBLE
CONFIG_BT_ENABLED=y
CONFIG_BT_NIMBLE_ENABLED=y
CONFIG_BT_NIMBLE_MAX_CONNECTIONS=1
CONFIG_BT_NIMBLE_ROLE_BROADCASTER=y
CONFIG_BT_NIMBLE_ROLE_PERIPHERAL=y
CONFIG_BT_NIMBLE_ROLE_CENTRAL=n
CONFIG_BT_NIMBLE_ROLE_OBSERVER=n

# WiFi
CONFIG_ESP_WIFI_ENABLED=y

# NVS
CONFIG_NVS_ENABLED=y

# lwIP socket API
CONFIG_LWIP_SO_REUSE=y

# FreeRTOS
CONFIG_FREERTOS_TIMER_TASK_STACK_DEPTH=4096
CONFIG_FREERTOS_HZ=1000

# Stacks
CONFIG_ESP_MAIN_TASK_STACK_SIZE=8192
```

## lib/Kconfig
```kconfig
rsource "crash_log/Kconfig"
rsource "device_shell/Kconfig"
rsource "eai_ble/Kconfig"
rsource "eai_log/Kconfig"
rsource "eai_osal/Kconfig"
rsource "eai_settings/Kconfig"
rsource "wifi_prov/Kconfig"
```

## lib/eai_ble/Kconfig
```kconfig
menuconfig EAI_BLE
	bool "EAI BLE - Portable BLE GATT Abstraction"
	help
	  Declarative BLE GATT service definition with backends for
	  Zephyr BT, NimBLE, and a POSIX stub for testing.

if EAI_BLE

choice EAI_BLE_BACKEND
	prompt "BLE Backend"
	default EAI_BLE_BACKEND_ZEPHYR

config EAI_BLE_BACKEND_ZEPHYR
	bool "Zephyr BT backend"
	depends on BT
	depends on BT_PERIPHERAL
	depends on BT_GATT_DYNAMIC_DB
	help
	  Uses Zephyr Bluetooth with runtime GATT service registration.

endchoice

endif # EAI_BLE
```

## lib/eai_ble/tests/testcase.yaml
```yaml
common:
  tags:
    - eai_ble
tests:
  libraries.eai_ble:
    build_only: true
    platform_allow:
      - nrf52840dk/nrf52840
```

## lib/eai_log/Kconfig
```kconfig
menuconfig EAI_LOG
	bool "EAI Log - Portable Logging"
	help
	  Header-only logging abstraction. Macros compile to the native
	  logging system on each platform (Zephyr LOG_*, ESP-IDF ESP_LOG*,
	  POSIX fprintf).

if EAI_LOG

choice EAI_LOG_BACKEND
	prompt "Log Backend"
	default EAI_LOG_BACKEND_ZEPHYR

config EAI_LOG_BACKEND_ZEPHYR
	bool "Zephyr backend"
	depends on LOG
	help
	  Passthrough to Zephyr LOG_INF/ERR/WRN/DBG macros.

endchoice

endif # EAI_LOG
```

## lib/eai_osal/Kconfig
```kconfig
menuconfig EAI_OSAL
	bool "EAI OSAL - OS Abstraction Layer"
	help
	  Portable OS abstraction layer providing thread, mutex, semaphore,
	  queue, timer, event, critical section, and time primitives.
	  Backend is selected at compile time via Kconfig.

if EAI_OSAL

choice EAI_OSAL_BACKEND
	prompt "OSAL Backend"
	default EAI_OSAL_BACKEND_ZEPHYR

config EAI_OSAL_BACKEND_ZEPHYR
	bool "Zephyr backend"
	depends on MULTITHREADING
	select EVENTS
	help
	  Use Zephyr RTOS kernel primitives as the OSAL backend.
	  Requires CONFIG_NUM_PREEMPT_PRIORITIES >= 32.

endchoice

endif # EAI_OSAL
```

## lib/eai_osal/tests/testcase.yaml
```yaml
common:
  tags:
    - eai_osal
tests:
  libraries.eai_osal:
    integration_platforms:
      - qemu_cortex_m3
```

## lib/eai_settings/Kconfig
```kconfig
menuconfig EAI_SETTINGS
	bool "EAI Settings - Portable Key-Value Store"
	help
	  Persistent key-value store abstraction. Backend selected at
	  compile time: Zephyr Settings, ESP-IDF NVS, or POSIX file-based.

if EAI_SETTINGS

choice EAI_SETTINGS_BACKEND
	prompt "Settings Backend"
	default EAI_SETTINGS_BACKEND_ZEPHYR

config EAI_SETTINGS_BACKEND_ZEPHYR
	bool "Zephyr Settings backend"
	depends on SETTINGS
	help
	  Uses Zephyr Settings subsystem (settings_save_one, settings_load_subtree).

endchoice

endif # EAI_SETTINGS
```

## lib/eai_settings/tests/testcase.yaml
```yaml
common:
  tags:
    - eai_settings
tests:
  libraries.eai_settings:
    platform_allow:
      - mps2/an385
    integration_platforms:
      - mps2/an385
```

## lib/eai_wifi/Kconfig
```kconfig
menuconfig EAI_WIFI
	bool "EAI WiFi - Portable WiFi Connection Manager"
	help
	  WiFi scan/connect/disconnect abstraction with backends for
	  Zephyr net_mgmt, ESP-IDF esp_wifi, and a POSIX stub for testing.

if EAI_WIFI

choice EAI_WIFI_BACKEND
	prompt "WiFi Backend"
	default EAI_WIFI_BACKEND_ZEPHYR

config EAI_WIFI_BACKEND_ZEPHYR
	bool "Zephyr net_mgmt backend"
	depends on WIFI
	depends on NETWORKING
	depends on NET_MGMT
	depends on NET_MGMT_EVENT
	help
	  Uses Zephyr net_mgmt WiFi and IPv4 event callbacks.

endchoice

endif # EAI_WIFI
```

## lib/eai_wifi/tests/testcase.yaml
```yaml
common:
  tags:
    - eai_wifi
tests:
  libraries.eai_wifi:
    build_only: true
    platform_allow:
      - nrf7002dk/nrf5340/cpuapp
```

## lib/wifi_prov/Kconfig
```kconfig
config WIFI_PROV
	bool "WiFi provisioning library"
	help
	  WiFi provisioning over BLE. Provides a custom GATT service
	  for scanning WiFi APs, sending credentials, and managing
	  connection state. Credentials persist across reboots.

config WIFI_PROV_BLE
	bool "BLE GATT service for WiFi provisioning"
	depends on WIFI_PROV
	depends on BT
	depends on BT_PERIPHERAL
	help
	  Custom BLE GATT service with characteristics for scan trigger,
	  scan results, credentials, status, and factory reset.

config WIFI_PROV_WIFI
	bool "WiFi manager (scan/connect)"
	depends on WIFI_PROV
	depends on WIFI
	depends on NETWORKING
	help
	  WiFi scanning and connection using Zephyr net_mgmt API.

config WIFI_PROV_CRED
	bool "Credential persistence via Settings"
	depends on WIFI_PROV
	depends on SETTINGS
	default y if WIFI_PROV
	help
	  Store/load/erase WiFi credentials using Zephyr Settings subsystem.

config WIFI_PROV_AUTO_CONNECT
	bool "Auto-connect on boot from stored credentials"
	depends on WIFI_PROV_WIFI
	depends on WIFI_PROV_CRED
	default y
	help
	  If stored credentials exist at boot, automatically connect to WiFi.
```

## lib/wifi_prov/tests/testcase.yaml
```yaml
common:
  tags:
    - wifi_prov
tests:
  libraries.wifi_prov:
    integration_platforms:
      - qemu_cortex_m3
```
